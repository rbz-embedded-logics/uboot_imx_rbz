## board/rbz/mod_imx8m_mini/Kconfig
```kconfig
if TARGET_MOD_IMX8M_MINI

config SYS_BOARD
	default "mod_imx8m_mini"

config SYS_VENDOR
	default "rbz"

config SYS_CONFIG_NAME
	default "mod_imx8m_mini"

config IMX_CONFIG
	default "board/rbz/mod_imx8m_mini/imximage-8mm.cfg"

endif
```

## board/rbz/mod_imx8m_nano/Kconfig
```kconfig
if TARGET_MOD_IMX8M_NANO

config SYS_BOARD
	default "mod_imx8m_nano"

config SYS_VENDOR
	default "rbz"

config SYS_CONFIG_NAME
	default "mod_imx8m_nano"

config IMX_CONFIG
	default "board/rbz/mod_imx8m_nano/imximage-8mn-lpddr4.cfg"

#source "board/rbz/common/Kconfig"

endif
```

## board/rbz/mod_imx8m_plus/Kconfig
```kconfig
if TARGET_MOD_IMX8M_PLUS

config SYS_BOARD
	default "mod_imx8m_plus"

config SYS_VENDOR
	default "rbz"

config SYS_CONFIG_NAME
	default "mod_imx8m_plus"

source "board/rbz/common/Kconfig"

endif
```
